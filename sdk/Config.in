## sdk/Config.in
```kconfig
config PACKAGE_opera-proxy
    prompt "Opera Proxy"
    tristate
    default n
    help
      Lightweight Opera proxy written in Go
source "package/opera-proxy/Config.in"
```
